## boards/shields/booxiedaisy/Kconfig.defconfig
```kconfig
if SHIELD_BOOXIEDAISY

config ZMK_KEYBOARD_NAME
    default "Booxie Daisy"

endif
```

## boards/shields/say_gay/Kconfig.defconfig
```kconfig
if SHIELD_SAY_GAY_DONGLE

config ZMK_KEYBOARD_NAME
    default "Say Gay"

config ZMK_SPLIT_ROLE_CENTRAL
    default y

config ZMK_SPLIT_BLE_CENTRAL_PERIPHERALS
    default 2

endif

if SHIELD_SAY_GAY_DONGLE || SHIELD_SAY_GAY_LEFT || SHIELD_SAY_GAY_RIGHT

config ZMK_SPLIT
    default y

endif
```

## boards/shields/say_gay/Kconfig.shield
```kconfig
config SHIELD_SAY_GAY_DONGLE
    def_bool $(shields_list_contains,say_gay_dongle)

config SHIELD_SAY_GAY_LEFT
    def_bool $(shields_list_contains,say_gay_left)

config SHIELD_SAY_GAY_RIGHT
    def_bool $(shields_list_contains,say_gay_right)
```

## config/west.yml
```yaml
manifest:
  remotes:
    - name: zmkfirmware
      url-base: https://github.com/zmkfirmware
    - name: badjeff
      url-base: https://github.com/badjeff
  projects:
    - name: zmk
      remote: zmkfirmware
      revision: main
      import: app/west.yml
    - name: prospector-zmk-module
      remote: badjeff
      revision: main
  self:
    path: config
```
